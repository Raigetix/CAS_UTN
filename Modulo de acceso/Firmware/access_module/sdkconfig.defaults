## Modulo de acceso/Firmware/access_module/sdkconfig.defaults
```kconfig
CONFIG_SPIRAM_SUPPORT=y
CONFIG_SPIRAM_BOOT_INIT=y
CONFIG_SPIRAM_USE_CAPS_ALLOC=y
CONFIG_SPIRAM_ALLOW_BSS_SEG_EXTERNAL_MEMORY=y
CONFIG_HEAP_POISONING_DISABLED=y
CONFIG_ESP32S3_DEFAULT_PSRAM_SIZE=8
CONFIG_LCD_RGB_BUFFER_NUM=1
```
